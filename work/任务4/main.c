#include <reg52.h>
#include<intrins.h>
#define uchar unsigned char
#define uint  unsigned int
sbit DIO = P3^4;
sbit S_CLK = P3^5;
sbit O_CLK = P3^6;
uchar q = 18;
int i,j;
uchar k;

uchar code tabel[19][8]={
0xFF,0xDD,0xDD,0xDD,0xC1,0xDD,0xDD,0xE3,//A
0x87,0xBB,0xBB,0x87,0xBB,0xBB,0x87,0xFF,//B
0xC7,0xBF,0xBF,0xBF,0xBF,0xBF,0xBF,0xC7,//C
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0xFF,0xFF,0xFF,0xFF,0xFF,0xFF,0xFF,0xFF //清屏
};


void delay(uint z)
{
    uint x, y;
    for (x = z; x > 0; x--)
        for (y = 144; y > 0; y--);
}
   
void Send_Byte(uchar dat)//8位串行输入函数
{
    for(i=0;i<8;i++)
    {
        S_CLK = 0;
        if(dat & 0x01)
        {
            DIO = 1;
        }
        else
        {
            DIO = 0;
        }
         S_CLK = 1;
          dat>>=1;
    }
}


void KeyValue()
{
    P3 = 0xf0;
    if (P3 != 0xf0) {
        delay(10);
        if (P3 != 0xf0) {
            switch (P3) {
                case 0xe0:q = 0;break;
                case 0xd0:q = 1;break;
                case 0xb0:q = 2;break;
                case 0x70:q = 3;break;
            }    
                
                P3 = 0x0f;
                switch(P3)
                {
                    case 0x0e:q =q;break;
                    case 0x0d:q = q+4;break;
                    case 0x0b:q = q+8;break;
                    case 0x07:q = q+12;break;
                }
                while(P3!=0x0f);
        }
    }
        P3 = 0xff;
        if(P3!=0xff)
        {

            delay(10);
            if(P3!=0xff)
            {
                switch(P3)
                {
                    case 0xfe:q = 16;break;
                    case 0xfd:q = 17;break;
                    case 0xfb:q = 18;break;
                    case 0xf7:q = 19;break;
                }
                while(P3!=0xff);
            }
        }

}

     

void main()
{    
 k = 0x80;
  for(j=0;j<8;j++)
    {
        O_CLK = 0;
        KeyValue();
        Send_Byte(tabel[q][j]);//一定要记住q是依据按键变化的，这部分我还没写
        Send_Byte(k);
        O_CLK = 1;
        k = _cror_(k,1);
    }
        
}
